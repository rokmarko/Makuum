## Kconfig.projbuild
```kconfig
menu "Makita Vacuum Configuration"

    config LED_GPIO
        int "LED GPIO number"
        range 0 39
        default 2
        help
            GPIO number for the status LED.
            Most ESP32 development boards have an onboard LED connected to GPIO2.

    config BT_DEVICE_NAME
        string "Bluetooth device name"
        default "Makita_Vacuum_Cleaner"
        help
            Name of the Bluetooth device as it appears to other devices.

    config VACUUM_ACTIVATION_TIMEOUT
        int "Vacuum activation timeout (seconds)"
        range 10 300
        default 30
        help
            How long the vacuum stays active after receiving a power-on signal.

    config DEBUG_MODE
        bool "Enable debug mode"
        default y
        help
            Enable additional debug logging and status information.

endmenu
```

## sdkconfig.defaults
```kconfig
# Makita Vacuum Cleaner ESP32 Configuration

#
# ESP32-specific
#
CONFIG_XTAL_FREQ_40=y
CONFIG_XTAL_FREQ_26=n
CONFIG_XTAL_FREQ_AUTO=n
CONFIG_XTAL_FREQ=40

#
# Bluetooth Low Energy (BLE) with NimBLE
#
CONFIG_BT_ENABLED=y
CONFIG_BT_NIMBLE_ENABLED=y

# Disable Bluedroid (use NimBLE instead)
CONFIG_BT_BLUEDROID_ENABLED=n
CONFIG_BT_CONTROLLER_ONLY=n

# Disable Classic Bluetooth
CONFIG_BT_CLASSIC_ENABLED=n

# BLE Controller
CONFIG_BT_CONTROLLER_ENABLED=y

# NimBLE Configuration
CONFIG_BT_NIMBLE_MAX_CONNECTIONS=1
CONFIG_BT_NIMBLE_ROLE_CENTRAL=y
CONFIG_BT_NIMBLE_ROLE_PERIPHERAL=n
CONFIG_BT_NIMBLE_ROLE_BROADCASTER=n
CONFIG_BT_NIMBLE_ROLE_OBSERVER=y
CONFIG_BT_GATT_MAX_SR_PROFILES=8
CONFIG_BT_GATT_MAX_SR_ATTRIBUTES=100
CONFIG_BT_GATTS_ENABLE=y
CONFIG_BT_GATTC_ENABLE=y
CONFIG_BT_BLE_SMP_ENABLE=y
CONFIG_BT_SMP_ENABLE=y
CONFIG_BT_BLE_42_FEATURES_SUPPORTED=y

#
# FreeRTOS
#
CONFIG_FREERTOS_HZ=1000

#
# Log output
#
CONFIG_LOG_DEFAULT_LEVEL_INFO=y
CONFIG_LOG_DEFAULT_LEVEL=3

#
# GPIO Configuration
#
CONFIG_LED_GPIO=2

#
# Component config
#

#
# Driver configurations
#
CONFIG_GPIO_CTRL_FUNC_IN_IRAM=y

#
# Main task
#
CONFIG_ESP_MAIN_TASK_STACK_SIZE=4096

#
# WiFi (disabled for this project)
#
CONFIG_ESP32_WIFI_ENABLED=n

#
# Memory
#
CONFIG_ESP_SYSTEM_EVENT_TASK_STACK_SIZE=4096
CONFIG_ESP_SYSTEM_EVENT_QUEUE_SIZE=32

#
# Serial flasher config
#
CONFIG_ESPTOOLPY_FLASHMODE_DIO=y
CONFIG_ESPTOOLPY_FLASHFREQ_40M=y
CONFIG_ESPTOOLPY_FLASHSIZE_4MB=y

#
# Partition Table
#
CONFIG_PARTITION_TABLE_SINGLE_APP=y

#
# Security features
#
CONFIG_ESP32_DEFAULT_CPU_FREQ_MHZ=240
```
